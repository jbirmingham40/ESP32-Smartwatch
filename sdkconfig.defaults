## sdkconfig.defaults
```kconfig
CONFIG_BT_NIMBLE_MEM_ALLOC_MODE_EXTERNAL=y
CONFIG_FREERTOS_HZ=1000
CONFIG_FREERTOS_USE_TRACE_FACILITY=y
CONFIG_FREERTOS_CHECK_STACKOVERFLOW=2
CONFIG_HEAP_CORRUPTION_DETECTION=light
CONFIG_I2S_SUPPRESS_DEPRECATE_WARN=y
CONFIG_PM_ENABLE=y
CONFIG_FREERTOS_USE_TICKLESS_IDLE=y
```
